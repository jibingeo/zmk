## app/drivers/zephyr/dts/bindings/sensor/azoteq,iqs5xx.yaml
```yaml
description: |
  Sensor driver for the Azoteq IQS5XX trackpad IC
compatible: "azoteq,iqs5xx"

include: base.yaml

on-bus: i2c

properties:
  dr-gpios:
    type: phandle-array
    required: true
    description: Data ready pin for the trackpad

  invert-x:
    type: boolean
    
  invert-y:
    type: boolean
```
